#include <Adafruit_Fingerprint.h>

SoftwareSerial mySerial(11,12);
Adafruit_Fingerprint finger = Adafruit_Fingerprint(&mySerial);

int p;

void setup()  
{ 
  while(!Serial);
  Serial.begin(9600);
  Serial.println("\n[ Upload + Store FlashMemory + Show Templete ]\n");

  // set the data rate for the sensor serial port
  // HIGH baudrate must use Hardware Serial (Serial3 / Serial2 / Serial1)
  finger.begin(57600);
  
  if (finger.verifyPassword()) {
    Serial.println("Found fingerprint sensor!");
  } else {
    Serial.println("Did not find fingerprint sensor :(");
    while (1);
  }
      
//uint8_t packet2[] = {0x1,0x60,0xF,0x95,0x0,0xFF,0xFE,0xFF,0xFE,0xFF,0xFE,0xFF,0xFE,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0x2E,0xF};
//uint8_t packet3[] = {0x0,0x0,0x0,0x0,0x0,0x0,0x0,0x0,0x0,0x0,0x0,0x0,0x0,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0x0,0x0};
//uint8_t packet4[] = {0x6C, 0x16, 0xC3, 0xD9, 0x60, 0xC8, 0xC3, 0xF9, 0x5C, 0x4A, 0x86, 0x39, 0x4E,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 0x00, 0x00};
//uint8_t packet5[] = {0x0,0x0,0x0,0x0,0x0,0x0,0x0,0x0,0x0,0x0,0x0,0x0,0x0,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0x0,0x0};
//uint8_t packet6[] = {0x23, 0x84, 0x56, 0x1E, 0x54, 0x05, 0x99, 0x5E, 0x1B, 0x0A, 0x14, 0xBE, 0x66,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 0xD6, 0xBD};
//uint8_t packet7[] = {0x53, 0xAE, 0xD7, 0xFD, 0x54, 0xB1, 0xD7, 0x1D, 0x0C, 0x37, 0x4D, 0x7D, 0x58,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 0x00, 0x00};
uint8_t packet2[] = {0x00,0x00,0x00,0x00,0x00,0x00,0x00,0x00,0x00,0x00,0x00,0x00,0x00,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0x00,0x00};
uint8_t packet3[] = {0x6D,0xB2,0xD6,0x7A,0x5D,0xC0,0x03,0x9A,0x30,0x3B,0xC6,0x7B,0x5B,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0x00,0x00};
uint8_t packet4[] = {0x03,0x01,0x59,0x32,0x83,0x00,0x00,0x00,0x00,0x00,0x00,0x00,0x00,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0x82,0x2E};
//uint8_t packet5[] = {0x1C,0x2F,0x85,0x0E,0x33,0x07,0x04,0xCF,0x17,0x0A,0xC8,0xCF,0x18,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0x82,0x22};
uint8_t packet5[] = {0x00,0x00,0x00,0x00,0x00,0x00,0x00,0x00,0x00,0x00,0x00,0x00,0x00,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0x00,0x00};




  
	Serial.print("\n===> Write Packet");
   //p = finger.uploadModel(packet2, packet3, packet4, packet5, packet6, packet7);		// Simpan di Char Buffer 01      
  p = finger.uploadModel(packet2, packet3, packet4,packet5);
  switch (p) {
    case FINGERPRINT_OK:
      Serial.println(" SUKSES");
      Serial.read();
      break;
    case FINGERPRINT_PACKETRECIEVEERR:
      Serial.println("Communication error");
      return p;
    case FINGERPRINT_BADPACKET:
      Serial.println("Bad packet");
      return p;      
    default:
	{
	Serial.println("\n==>[SUKSES] UploadModel = ");
      //return p;
	}
  }
  int id = 103;		// --> id = FlashMemory Place
  Serial.print("\n==>[SUKSES] StoreModel + ID = ");Serial.print(id);
  p = finger.storeModel(id);									// taruh di ID = 0 pada flash memory FP
  if (p == FINGERPRINT_OK) {
    Serial.println(" Stored!");
  } else if (p == FINGERPRINT_PACKETRECIEVEERR) {
    Serial.println("Communication error");
    return p;
  } else if (p == FINGERPRINT_BADLOCATION) {
    Serial.println("Could not store in that location");
    return p;
  } else if (p == FINGERPRINT_FLASHERR) {
    Serial.println("Error writing to flash");
    return p;
  } else {
    Serial.println("Unknown error");
    return p;
  }
}

void loop()
{}


